## projects/ios_screen_mirror/main/Kconfig.projbuild
```kconfig
menu "iOS screen mirror"
config MIRROR_USB_CONSOLE_WAIT_MS
    int "Startup wait for USB CDC terminal (milliseconds)"
    range 0 10000
    default 3000
    help
        Give the host a bounded interval to enumerate and open the USB-HS CDC
        port before BSP and Wi-Fi logs begin. Startup continues after timeout.

config MIRROR_NAME
    string "AirPlay receiver name"
    default "Mosaico Mirror"
config MIRROR_WIFI_SSID
    string "Wi-Fi SSID (blank: use saved ESP-IDF station configuration)"
    default "Redmi_YK"
config MIRROR_WIFI_PASSWORD
    string "Wi-Fi password"
    default "12345678"
config MIRROR_WIDTH
    int "Display width advertised to iPhone"
    range 160 480
    default 320
config MIRROR_HEIGHT
    int "Display height advertised to iPhone"
    range 160 480
    default 320
config MIRROR_FPS
    int "Refresh rate advertised to iPhone (advisory)"
    range 5 30
    default 15
config MIRROR_MAX_PIXELS
    int "Maximum coded frame pixels accepted (macroblock aligned)"
    range 25600 921600
    default 307200
    help
        Bound decoding cost and memory before feeding SPS into esp_h264.
        The phone may ignore the advertised display size/refresh rate.
endmenu
```

## projects/ios_screen_mirror/sdkconfig.defaults
```kconfig
CONFIG_IDF_TARGET="esp32s31"
CONFIG_IDF_EXPERIMENTAL_FEATURES=y
CONFIG_COMPILER_OPTIMIZATION_PERF=y
CONFIG_ESPTOOLPY_FLASHMODE_QIO=y
CONFIG_ESPTOOLPY_FLASHSIZE_16MB=y
CONFIG_PARTITION_TABLE_CUSTOM=y
CONFIG_PARTITION_TABLE_CUSTOM_FILENAME="partitions.csv"
# The app installs esp_tinyusb CDC on S31's sole USB-HS OTG port before BSP/Wi-Fi.
# Neither the ROM USB console nor the separate Serial/JTAG controller owns stdio.
CONFIG_ESP_CONSOLE_NONE=y
CONFIG_ESP_CONSOLE_SECONDARY_NONE=y
CONFIG_VFS_SUPPORT_IO=y
CONFIG_TINYUSB_CDC_ENABLED=y
CONFIG_TINYUSB_CDC_COUNT=1
CONFIG_TINYUSB_CDC_RX_BUFSIZE=512
CONFIG_TINYUSB_CDC_TX_BUFSIZE=4096
CONFIG_TINYUSB_CDC_EP_BUFSIZE=512
CONFIG_TINYUSB_DEBUG_LEVEL=0
CONFIG_TINYUSB_DESC_MANUFACTURER_STRING="ESP-Mosaico"
CONFIG_TINYUSB_DESC_PRODUCT_STRING="Mosaico Mirror USB Console"
CONFIG_TINYUSB_DESC_CDC_STRING="Log Console"
CONFIG_TINYUSB_DESC_SERIAL_STRING=""
CONFIG_SPIRAM=y
CONFIG_SPIRAM_SPEED_250M=y
CONFIG_SPIRAM_XIP_FROM_PSRAM=y
CONFIG_SPIRAM_MEMTEST=n
CONFIG_BSP_DISPLAY_ENABLE=y
CONFIG_BSP_DISPLAY_LVGL_ENABLE=n
CONFIG_BSP_CO5300_ENABLE_TE=n
CONFIG_LWIP_MAX_SOCKETS=16
CONFIG_LWIP_TCPIP_TASK_STACK_SIZE=4096
CONFIG_MBEDTLS_SHA512_C=y
CONFIG_MBEDTLS_AES_HW_SMALL_DATA_LEN_OPTIM=y
CONFIG_PTHREAD_TASK_STACK_SIZE_DEFAULT=16384
CONFIG_ESP_MAIN_TASK_STACK_SIZE=8192
CONFIG_ESP_COREDUMP_ENABLE_TO_FLASH=y
```
